## boards/arm/efr32xG24_dk2601b/efr32xG24_dk2601b_defconfig
```kconfig
# SPDX-License-Identifier: Apache-2.0

CONFIG_SOC_SERIES_EFR32MG24=y
CONFIG_BOARD_EFR32XG24_DK2601B=y
CONFIG_ARM_MPU=y
CONFIG_CONSOLE=y
CONFIG_UART_CONSOLE=y
CONFIG_SERIAL=y
CONFIG_CORTEX_M_SYSTICK=y
CONFIG_GPIO=y
CONFIG_SYS_CLOCK_HW_CYCLES_PER_SEC=76800000
CONFIG_CMU_HFCLK_HFXO=y
CONFIG_SOC_GECKO_EMU_DCDC=y
CONFIG_SOC_GECKO_EMU_DCDC_MODE_ON=y
CONFIG_FLASH_BASE_ADDRESS=0x08000000
CONFIG_COUNTER_GECKO_RTCC=n
CONFIG_CMU_HFCLK_LFXO=y
CONFIG_HWINFO_GECKO=n
```

## soc/arm/silabs_exx32/efr32bg13p/Kconfig.series
```kconfig
# Silicon Labs EFR32BG13P (Blue Gecko) MCU

# Copyright (c) 2020 Piotr Mienkowski
# SPDX-License-Identifier: Apache-2.0

config SOC_SERIES_EFR32BG13P
	bool "EFR32BG13P Series MCU"
	select ARM
	select CPU_CORTEX_M4
	select CPU_CORTEX_M_HAS_DWT
	select CPU_HAS_FPU
	select CPU_HAS_ARM_MPU
	select CLOCK_CONTROL
	select SOC_FAMILY_EXX32
	select HAS_SILABS_GECKO
	select HAS_SWO
	select SOC_GECKO_HAS_INDIVIDUAL_PIN_LOCATION
	select SOC_GECKO_CMU
	select SOC_GECKO_EMU
	select SOC_GECKO_GPIO
	select SOC_GECKO_RTCC
	select SOC_GECKO_TRNG
	select SOC_GECKO_DEV_INIT
	select SERIES_1
	help
	  Enable support for EFR32BG13P Blue Gecko MCU series
```

## soc/arm/silabs_exx32/efr32mg24/Kconfig.defconfig.series
```kconfig
# Silicon Labs EFR32MG24 (Mighty Gecko) MCU configuration options

# Copyright (c) 2021 Sateesh Kotapati
# SPDX-License-Identifier: Apache-2.0

if SOC_SERIES_EFR32MG24

config SOC_SERIES
	default "efr32mg24"

config SOC_PART_NUMBER
	default "EFR32MG24B310F1536IM48" if SOC_PART_NUMBER_EFR32MG24B310F1536IM48

config NUM_IRQS
	# must be >= the highest interrupt number used
	default 75
	
config PM
	default n
	select COUNTER

choice PM_POLICY
	default PM_POLICY_CUSTOM
	depends on PM
endchoice

source "soc/arm/silabs_exx32/efr32mg24/Kconfig.defconfig.efr32mg24"

endif # SOC_SERIES_EFR32MG24
```

## soc/arm/silabs_exx32/efr32mg24/Kconfig.series
```kconfig
# Silicon Labs EFR32BG22 (Blue Gecko) MCU

# Copyright (c) 2021 Sateesh Kotapati
# SPDX-License-Identifier: Apache-2.0

config SOC_SERIES_EFR32MG24
	bool "EFR32MG24 Series MCU"
	select ARM
	select CPU_CORTEX_M33
	select CPU_HAS_FPU
	select CPU_HAS_ARM_MPU
	select CPU_HAS_ARM_SAU
	select ARMV8_M_DSP
	select ARM_TRUSTZONE_M
	select CLOCK_CONTROL
	select SOC_FAMILY_EXX32
	select HAS_SILABS_GECKO
	select HAS_SWO
	select SOC_GECKO_CMU
	select SOC_GECKO_EMU
	select SOC_GECKO_GPIO
	select SOC_GECKO_TRNG
	select SOC_GECKO_DEV_INIT
	select SERIES_2
	select COUNTER_GECKO_STIMER
	select SOC_GECKO_SEMAILBOX
	help
	  Enable support for EFR32MG24 Mighty Gecko MCU series
```
